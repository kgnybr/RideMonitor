#include <Wire.h>
#include <Adafruit_GFX.h>
#include <Adafruit_SSD1306.h>
#include <Adafruit_BMP085.h>
#include <Bounce2.h>

Adafruit_BMP085 bmp;

#define SCREEN_WIDTH 128
#define SCREEN_HEIGHT 32
const int ignitionPin = 2;
volatile unsigned long pulseCount = 0;
unsigned long previousTime = 0;
unsigned int rpm = 0;
const int buttonPin = 10;
const int voltagePin = A0;
const float voltage_carpan = 0.0215046;  // 3.3k ve 1k icin
const int ledPins[] = { 3, 4, 5, 6, 7, 8, 9 };
const int ledCount = sizeof(ledPins) / sizeof(ledPins[0]);  
Bounce debouncer = Bounce();                                
int menuSayac = 0;
float pressure_hPa;
float akuGerilimi;
int analogDeger;


Adafruit_SSD1306 display(SCREEN_WIDTH, SCREEN_HEIGHT, &Wire, -1);


const uint8_t carLogo[] PROGMEM = {
  0x00, 0x00, 0x00, 0x00, 0x00, 0x00, 0x00, 0x00, 0x00, 0x00, 0x00, 0x00, 0x00, 0x00, 0x00, 0x00,
  0x00, 0x00, 0x00, 0x00, 0x00, 0x00, 0x00, 0x00, 0x00, 0x00, 0x00, 0x00, 0x00, 0x00, 0x00, 0x00,
  0x00, 0x00, 0x00, 0x00, 0x00, 0x00, 0x00, 0x00, 0x00, 0x00, 0x00, 0x00, 0x00, 0x00, 0x00, 0x00,
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  0x00, 0x00, 0x00, 0x00, 0x00, 0x00, 0x00, 0x00, 0x00, 0x00, 0x00, 0x00, 0x00, 0x00, 0x00, 0x00
};
const uint8_t tempLogo[] PROGMEM = {
  0x01, 0xf8, 0x00, 0x00, 0x00, 0x00, 0x00, 0x00, 0x00, 0x00, 0x00, 0x00, 0x00, 0x00, 0x00, 0x00,
  0x03, 0xfc, 0x00, 0x00, 0x00, 0x00, 0x00, 0x00, 0x00, 0x00, 0x00, 0x00, 0x00, 0x00, 0x00, 0x00,
  0x03, 0xde, 0x00, 0x00, 0x00, 0x00, 0x00, 0x00, 0x00, 0x00, 0x00, 0x00, 0x00, 0x00, 0x00, 0x00,
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  0x01, 0xfc, 0x00, 0x00, 0x00, 0x00, 0x00, 0x00, 0x00, 0x00, 0x00, 0x00, 0x00, 0x00, 0x00, 0x00
};
const uint8_t altLogo[] PROGMEM = {
  0x00, 0x00, 0x00, 0x00, 0x00, 0x00, 0x00, 0x00, 0x00, 0x00, 0x00, 0x00, 0x00, 0x00, 0x00, 0x00,
  0x00, 0x00, 0x00, 0x00, 0x00, 0x00, 0x00, 0x00, 0x00, 0x00, 0x00, 0x00, 0x00, 0x00, 0x00, 0x00,
  0x00, 0x00, 0x00, 0x00, 0x00, 0x00, 0x00, 0x00, 0x00, 0x00, 0x00, 0x00, 0x00, 0x00, 0x00, 0x00,
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  0x00, 0x00, 0x00, 0x00, 0x00, 0x00, 0x00, 0x00, 0x00, 0x00, 0x00, 0x00, 0x00, 0x00, 0x00, 0x00
};
const uint8_t atmLogo[] PROGMEM = {
  0x00, 0x00, 0x00, 0x00, 0x00, 0x00, 0x00, 0x00, 0x00, 0x00, 0x00, 0x00, 0x00, 0x00, 0x00, 0x00,
  0x00, 0x00, 0x00, 0x00, 0x00, 0x00, 0x00, 0x00, 0x00, 0x00, 0x00, 0x00, 0x00, 0x00, 0x00, 0x00,
  0x00, 0x00, 0x00, 0x00, 0x00, 0x00, 0x00, 0x00, 0x00, 0x00, 0x00, 0x00, 0x00, 0x00, 0x00, 0x00,
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  0x00, 0x00, 0x00, 0x00, 0x00, 0x00, 0x00, 0x00, 0x00, 0x00, 0x00, 0x00, 0x00, 0x00, 0x00, 0x00
};
const uint8_t rpmLogo[] PROGMEM = {
  0x00, 0x00, 0x00, 0x00, 0x00, 0x00, 0x00, 0x00, 0x00, 0x00, 0x00, 0x00, 0x00, 0x00, 0x00, 0x00,
  0x00, 0x00, 0x00, 0x00, 0x00, 0x00, 0x00, 0x00, 0x00, 0x00, 0x00, 0x00, 0x00, 0x00, 0x00, 0x00,
  0x00, 0x00, 0x00, 0x00, 0x00, 0x00, 0x00, 0x00, 0x00, 0x00, 0x00, 0x00, 0x00, 0x00, 0x00, 0x00,
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  0x00, 0x00, 0x00, 0x00, 0x00, 0x00, 0x00, 0x00, 0x00, 0x00, 0x00, 0x00, 0x00, 0x00, 0x00, 0x00
};
const uint8_t akuLogo[] PROGMEM = {
  0x00, 0x00, 0x00, 0x00, 0x00, 0x00, 0x00, 0x00, 0x00, 0x00, 0x00, 0x00, 0x00, 0x00, 0x00, 0x00,
  0x03, 0x00, 0x00, 0x00, 0x30, 0x00, 0x00, 0x00, 0x00, 0x00, 0x00, 0x00, 0x00, 0x00, 0x00, 0x00,
  0x07, 0x00, 0x00, 0x00, 0x70, 0x00, 0x00, 0x00, 0x00, 0x00, 0x00, 0x00, 0x00, 0x00, 0x00, 0x00,
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  0x00, 0x00, 0x00, 0x00, 0x00, 0x00, 0x00, 0x00, 0x00, 0x00, 0x00, 0x00, 0x00, 0x00, 0x00, 0x00
};

void setup() {
  pinMode(buttonPin, INPUT_PULLUP);
  pinMode(ignitionPin, INPUT);
  attachInterrupt(digitalPinToInterrupt(ignitionPin), countPulse, RISING);
  for (int i = 0; i < ledCount; i++) {
    pinMode(ledPins[i], OUTPUT);
    digitalWrite(ledPins[i], LOW);
  }
  debouncer.attach(buttonPin);
  debouncer.interval(5);  
  Serial.begin(9600);
  if (!bmp.begin()) {
    Serial.println("BMP085 başlatılamadı, sensör bulunamadı");
    while (1)
      ;  
  }
  display.begin(SSD1306_SWITCHCAPVCC, 0x3C);  
  display.setTextColor(WHITE);               
  menuWelcome();
  delay(2000);
  menuAIO();
  delay(5000);
}

void loop() {
  unsigned long currentTime = millis();
  if (currentTime - previousTime >= 250) {
    
    unsigned long frequency = 4*pulseCount;
    rpm = (frequency * 60) / 2;
    pulseCount = 0;
    previousTime = currentTime;
  }
  rpmLed(rpm);
  debouncer.update();
  if (debouncer.fell()) {
    menuSayac++;
    if (menuSayac == 5) menuSayac = 0;
  }
  if (menuSayac == 0) {
    menuRPM();
  } else if (menuSayac == 1) {
    menuTemp();
  } else if (menuSayac == 2) {
    menuAltitude();
  } else if (menuSayac == 3) {
    menuPressure();
  } else if (menuSayac == 4) {
    menuVoltage();
  }
}


void menuWelcome() {
  display.clearDisplay();
  display.drawBitmap(0, 0, carLogo, SCREEN_WIDTH, SCREEN_HEIGHT, WHITE);
  display.display();
}
void menuTemp() {
  display.clearDisplay();
  display.drawBitmap(0, 0, tempLogo, SCREEN_WIDTH, SCREEN_HEIGHT, WHITE);
  display.setCursor(24, 8);
  display.setTextSize(2);
  display.print(bmp.readTemperature());
  display.print(" C");
  display.display();
}
void menuAltitude() {
  display.clearDisplay();
  display.drawBitmap(0, 0, altLogo, SCREEN_WIDTH, SCREEN_HEIGHT, WHITE);
  display.setCursor(24, 8);
  display.setTextSize(2);
  display.print(bmp.readAltitude());
  display.print(" m");
  display.display();
}
void menuPressure() {
  pressure_hPa = bmp.readPressure() / 100.0;
  display.clearDisplay();
  display.drawBitmap(0, 0, atmLogo, SCREEN_WIDTH, SCREEN_HEIGHT, WHITE);
  display.setCursor(30, 8);
  display.setTextSize(2);
  display.print(pressure_hPa);
  display.setTextSize(1);
  display.print(" hPa");
  display.display();
}
void menuRPM() {
  display.clearDisplay();
  display.drawBitmap(0, 0, rpmLogo, SCREEN_WIDTH, SCREEN_HEIGHT, WHITE);
  display.setCursor(40, 8);
  display.setTextSize(2);
  display.print(rpm);
  display.display();
}
void menuVoltage() {
  analogDeger = analogRead(voltagePin);
  akuGerilimi = analogDeger * voltage_carpan;
  display.clearDisplay();
  display.drawBitmap(0, 0, akuLogo, SCREEN_WIDTH, SCREEN_HEIGHT, WHITE);
  display.setCursor(45, 8);
  display.setTextSize(2);
  display.print(akuGerilimi, 1);
  display.print(" V");
  display.display();
}
void menuAIO() {
  analogDeger = analogRead(voltagePin);
  akuGerilimi = analogDeger * voltage_carpan;
  display.clearDisplay();
  display.setCursor(0, 0);
  display.setTextSize(1);
  display.print("Aku Voltaji: ");
  display.print(akuGerilimi, 1);
  display.print(" V");
  display.setCursor(0, 9);
  display.print("Sicaklik: ");
  display.print(bmp.readTemperature());
  display.print(" C");
  display.setCursor(0, 18);
  display.print("Rakim: ");
  display.print(bmp.readAltitude());
  display.print(" m");
  display.display();
}
void countPulse() {
  pulseCount++;
}
void rpmLed(int rpm) {
   for (int i = 0; i < ledCount; i++) {
    if (rpm > i * 1000) {
      digitalWrite(ledPins[i], HIGH); 
    } else {
      digitalWrite(ledPins[i], LOW); 
  }

}

